## boards/shields/akab/Kconfig.defconfig
```kconfig
if SHIELD_AKAB_LEFT
 
config ZMK_KEYBOARD_NAME
    default "Akab"
 
config ZMK_SPLIT_ROLE_CENTRAL
    default y

endif
 
if SHIELD_AKAB_LEFT || SHIELD_AKAB_RIGHT
 
config ZMK_SPLIT
    default y

endif
```

## boards/shields/akab/Kconfig.shield
```kconfig
config SHIELD_AKAB_LEFT
    def_bool $(shields_list_contains,akab_left)

config SHIELD_AKAB_RIGHT
    def_bool $(shields_list_contains,akab_right)
```
